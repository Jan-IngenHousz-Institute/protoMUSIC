## components/mqtt_client/Kconfig.projbuild
```kconfig
menu "Ambyte MQTT Client"

    config AMBYTE_DEVICE_ID
        string "Device ID"
        default "1"
        help
            Canonical device identity used in MQTT topics and as the measure_id prefix.
            measure_id = DEVICE_ID * 1000000 + sequence (e.g. device "1" → 1000001, 1000002…).
            Must be a numeric ASCII string to double as the persisted prefix.

    config AMBYTE_MQTT_URI
        string "MQTT Broker URI"
        default "mqtts://localhost:8883"
        help
            Full broker URI, e.g. mqtts://xxxxxx.iot.us-east-1.amazonaws.com:8883

    config AMBYTE_MQTT_CLIENT_ID
        string "MQTT Client ID"
        default "ambyte_device_1"
        help
            Unique client identifier presented to the broker. Must differ between devices.

    config AMBYTE_MQTT_TOPIC_ROOT
        string "MQTT Topic Root"
        default "ambyte"
        help
            Root prefix for all telemetry topics.
            Full topic: <root>/<device_id>/<measure_type>/<measure_id>

endmenu
```

## main/Kconfig.projbuild
```kconfig
menu "Ambbyte IoT Settings"

config AMBYTE_WIFI_SSID
    string "Wi-Fi SSID"
    default "__UNPROVISIONED__"
    help
        Provision this on the build machine with a local sdkconfig or menuconfig change.
        Do not commit live Wi-Fi credentials to source control.

config AMBYTE_WIFI_PASSWORD
    string "Wi-Fi Password"
    default "__UNPROVISIONED__"
    help
        Provision this on the build machine with a local sdkconfig or menuconfig change.
        Leave it empty only for an intentionally open network.

endmenu
```

## sdkconfig.defaults
```kconfig
CONFIG_AMBYTE_WIFI_SSID="__UNPROVISIONED__"
CONFIG_AMBYTE_WIFI_PASSWORD="__UNPROVISIONED__"
# CONFIG_ESP_CONSOLE_UART_DEFAULT is not set
CONFIG_ESP_CONSOLE_USB_SERIAL_JTAG=y
CONFIG_ESP_CONSOLE_SECONDARY_NONE=y
# CONFIG_ESP_CONSOLE_SECONDARY_USB_SERIAL_JTAG is not set
CONFIG_ESPTOOLPY_FLASHSIZE_16MB=y
# CONFIG_ESPTOOLPY_FLASHSIZE_4MB is not set
CONFIG_ESPTOOLPY_FLASHSIZE="16MB"
CONFIG_ESPTOOLPY_FLASHSIZE_DETECT=y
CONFIG_PARTITION_TABLE_CUSTOM=y
CONFIG_PARTITION_TABLE_CUSTOM_FILENAME="partitions.csv"
# CONFIG_PARTITION_TABLE_SINGLE_APP is not set
CONFIG_MQTT_PROTOCOL_5=y
# CONFIG_MQTT_PROTOCOL_311 is not set
CONFIG_ESP_TASK_WDT_PANIC=y
CONFIG_ESP_COREDUMP_ENABLE_TO_FLASH=y
CONFIG_HEAP_POISONING_LIGHT=y
CONFIG_COMPILER_STACK_CHECK_MODE_NORM=y
CONFIG_ESP_MAIN_TASK_STACK_SIZE=16384
# Provisioning is delivered via host-side NVS pre-population (tools/extra_script.py),
# so the Bluetooth stack is left out of the build entirely.
# CONFIG_BT_ENABLED is not set
# FAT long filename support (required for SQLite DB file)
# CONFIG_FATFS_LFN_NONE is not set
CONFIG_FATFS_LFN_HEAP=y
CONFIG_FATFS_MAX_LFN=255
# TLS inbound record buffer: 16 KiB default -> 8 KiB. Frees ~8 KiB of internal
# heap and, crucially, lets MQTT *reconnect* on a fragmented heap (a 16 KiB
# contiguous block was unobtainable mid-run -> mbedtls ALLOC_FAILED). 8 KiB
# still holds the broker's TLS handshake cert record. OUT stays 4 KiB
# (asymmetric content len is already enabled).
CONFIG_MBEDTLS_SSL_IN_CONTENT_LEN=8192
# Dynamic TLS record buffers: free the 8 KiB IN / 4 KiB OUT record buffers
# *between* records and reallocate per-record sized to need, instead of holding
# all 12 KiB for the connection's lifetime. This is the targeted fix for the OOM
# death-spiral seen under load: an MQTT write stall -> esp-mqtt auto-reconnect
# churned those 12 KiB through an already-fragmented heap until a 3 KiB malloc
# and the Wi-Fi driver (wifi:m f null) starved. We publish one ~3 KiB event every
# few seconds, so we are heap-bound, not throughput-bound — a great trade.
# The further cert/key-free options (FREE_CA_CERT, ~6 KiB) are gated behind
# MBEDTLS_DYNAMIC_FREE_CONFIG_DATA, which frees the client private key after the
# handshake and is flagged in IDF's own help as problematic for reconnects — a
# real risk on our mutual-TLS link. Held back; revisit only if DYNAMIC_BUFFER
# alone doesn't give enough headroom (watch the sync_runner "heap:" line).
CONFIG_MBEDTLS_DYNAMIC_BUFFER=y
# Standalone heap leak tracing — DIAGNOSTIC ONLY. It found the leak (a Lua GC
# starvation: sched.run blocks in C between cycles, starving Lua's alloc-driven
# incremental GC, so measurement result tables piled up ~6 KB/min). Fixed with a
# collectgarbage("collect") per sched.run cycle. Re-enable these two lines (the
# `heaptrace start|stop|dump` CLI command compiles back in via #ifdef) if another
# leak ever needs chasing; off by default to reclaim ~17 KiB static .bss.
# CONFIG_HEAP_TRACING_STANDALONE=y
# CONFIG_HEAP_TRACING_STACK_DEPTH=4
```
